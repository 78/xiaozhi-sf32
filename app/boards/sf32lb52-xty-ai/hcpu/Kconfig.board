## app/boards/sf32lb52-xty-ai/hcpu/Kconfig.board
```kconfig
config BSP_USING_BOARD_SF32LB52_XTY_AI
    bool
    select SOC_SF32LB52X
    select BF0_HCPU
    default y

rsource "../Kconfig.board"
```

## app/project/Kconfig.proj
```kconfig
#APP specific configuration.
config BF0_HCPU
    bool
    default y

config CUSTOM_MEM_MAP
    bool 
	select custom_mem_map
	default y    

config XIAOZHI_USING_MQTT
    bool "xiaozhi_using_mqtt"
	default n

config CONFIG_IOT_PROTOCOL_MCP
    bool "using mcp protocol"
	default y 

comment "------------Project configuration-----------"



config BLUETOOTH_NAME
    string "Bluetooth device name"
    default "sifli-pan"
    help
        Specify the Bluetooth device name for the application.

config BT_NAME_MAC_ENABLE
    bool "Append the MAC address to the Bluetooth name"
    default n
    help
        Append the MAC address to the Bluetooth name, such as "sifli-pan-12:34:56:78:9a:bc".

# KWS
config KWS_ENABLE_DEFAULT
    bool "Enable KWS by default"
    default n
    help
        Enable KWS (Keyword Spotting) by default in the application. 


# EZIP
config EZIP_BINARY_MODE
    bool "Enable EZIP binary mode"
    depends on BSP_USING_BOARD_SF32LB52_NANO_A128R16
    default y
    help
        Enable EZIP binary mode for image resources.
# TINY_TTF
config TINY_TTF_MODE
    bool "Enable Tiny TTF font support"
    depends on BSP_USING_BOARD_SF32LB52_NANO_A128R16
    default y
    help
        Enable Tiny TTF font support for the application.

config LOW_POWER_NO_SHUTDOWN
    bool "low power dont shutdown"
    default n
```

## app/project/Kconfig.tmp
```kconfig
source "E:/Desktop/ProjectJamal/SF32_GITEE/SDK/sifli-sdk/customer/boards/sf32lb52-xty-ai/hcpu/Kconfig.board"
source "$SIFLI_SDK/customer/boards/Kconfig.v2"
source "$SIFLI_SDK/Kconfig.v2"
rsource "Kconfig.proj"
```
